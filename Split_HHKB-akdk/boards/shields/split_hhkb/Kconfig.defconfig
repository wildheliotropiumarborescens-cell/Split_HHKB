## Split_HHKB-akdk/boards/shields/split_hhkb/Kconfig.defconfig
```kconfig
if SHIELD_SPLIT_HHKB_LEFT

config ZMK_KEYBOARD_NAME
    default "split_hhkb"

endif

if SHIELD_SPLIT_HHKB_LEFT || SHIELD_SPLIT_HHKB_RIGHT

config ZMK_SPLIT
    default y

endif
```

## Split_HHKB-akdk/boards/shields/split_hhkb/Kconfig.shield
```kconfig
config SHIELD_SPLIT_HHKB_LEFT
    def_bool $(shields_list_contains,split_hhkb_left)
config SHIELD_SPLIT_HHKB_RIGHT
    def_bool $(shields_list_contains,split_hhkb_right)
```
